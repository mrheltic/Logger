#include <SPI.h>
#include <Wire.h>
#include <Adafruit_SSD1306.h>
#include <Adafruit_GFX.h>
#include <Fonts/FreeMonoBoldOblique24pt7b.h>

#define SCREEN_WIDTH 128 
#define SCREEN_HEIGHT 32 
#define OLED_RESET     4 
Adafruit_SSD1306 Display(SCREEN_WIDTH, SCREEN_HEIGHT, &Wire, OLED_RESET);

//variabili di stato
int mode = 0;

//pulsanti di controllo
int psx = 7;
int pcnt = 4;
int pdx = 2;

//capacimetro variabili e grafica
int r = 0;
int i = 0;
const int OUT_PIN = A2;
const int IN_PIN = A3;
const int MAX_ADC_VALUE = 1023;
const float IN_STRAY_CAP_TO_GND = 24.48;
const float IN_CAP_TO_GND = IN_STRAY_CAP_TO_GND;
const float R_PULLUP = 34.8;
static const unsigned char PROGMEM condensatore[] =
{ 0x11, 0x00, 0x00, 0x00, 0x00, 0x00, 0x00, 0x00, 0x00, 0x00, 0x00, 0x00, 0x00, 0x00, 0x00, 0x00,
0x11, 0x00, 0x00, 0x00, 0x00, 0x00, 0x00, 0x00, 0x00, 0x00, 0x00, 0x00, 0x00, 0x00, 0x00, 0x00,
0x11, 0x00, 0x00, 0x00, 0x00, 0x00, 0x00, 0x00, 0x00, 0x00, 0x00, 0x00, 0x00, 0x00, 0x00, 0x00,
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0x00, 0x00, 0x00, 0x00, 0x00, 0x00, 0x00, 0x00, 0x00, 0x00, 0x00, 0x00, 0x00, 0x00, 0x00, 0x00
};

//voltmetro variabili
int analogInput = 0;
float vout = 0.0;
float vin = 0.0;
float R1 = 100000.0; // inserire valore esatto resistenza R1 (100K)
float R2 = 10240.0; // inserire valore esatto resistenza R2 (10K)
int value = 0;
static const unsigned char PROGMEM voltt[] =
{ 0x00, 0x00, 0x00, 0x00, 0x00, 0x00, 0x00, 0x00, 0x00, 0x00, 0x00, 0x00, 0x00, 0x00, 0x00, 0x00,
0x00, 0x00, 0x00, 0x00, 0x00, 0x00, 0x00, 0x00, 0x00, 0x00, 0x00, 0x00, 0x00, 0x00, 0x00, 0x00,
0x00, 0x00, 0x00, 0x00, 0x00, 0x00, 0x00, 0x00, 0x00, 0x00, 0x00, 0x00, 0x00, 0x00, 0x00, 0x00,
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0x00, 0x00, 0x00, 0x00, 0x00, 0x00, 0x00, 0x00, 0x00, 0x00, 0x00, 0x00, 0x00, 0x00, 0x00, 0x00
};

void setup() {
Serial.begin(9600);
Display.begin(SSD1306_SWITCHCAPVCC, 0x3C); 

//pinMode
pinMode(psx, INPUT_PULLUP);
pinMode(pcnt, INPUT_PULLUP);
pinMode(pdx, INPUT_PULLUP);
pinMode(IN_PIN, OUTPUT);
pinMode(OUT_PIN, OUTPUT);
pinMode(IN_PIN, OUTPUT);

//intro
Display.clearDisplay();
}

void loop() {
  if(digitalRead(psx)==0 && mode>0){
    mode--;
  }
  if(digitalRead(pdx)==0 && mode<1){
    mode++;
  }
  //voltmetro
if(mode==0){
    value = analogRead(analogInput);
  vout = (value * 5.0) / 1024.0; //apposta di 5 volt, inserire la vera tenstione fra 5V e gnd
  vin = vout / (R2 / (R1 + R2));
  if (vin < 0.09) {
    vin = 0.0;
  }
  Display.drawBitmap(0, 0, voltt, 128, 32, WHITE);
  Display.setTextSize(1);
  Display.setTextColor(WHITE);
  Display.setCursor(73, 0);
  Display.println("Voltmetro");
  Display.setTextColor(BLACK, WHITE);
  Display.setCursor(0, 33);
  Display.println(Format(r * 7.99 / 204.6, 3, 2));
  Display.setTextSize(2);
  Display.setTextColor(WHITE);
  Display.setCursor(0, 13);
  Display.print(vin);
  Display.print(" V");
  Display.display();
  Display.setTextSize(2);
  Display.setTextColor(WHITE);
  Display.setCursor(0, 13);
  Display.print(vin);
  Display.display();
}

//capacimetro
if(mode==1){
  pinMode(IN_PIN, INPUT);
digitalWrite(OUT_PIN, HIGH);
int val = analogRead(IN_PIN);
digitalWrite(OUT_PIN, LOW);

  Display.setTextColor(BLACK, WHITE);
  Display.setCursor(0, 33);
  Display.println(Format(r * 7.99 / 204.6, 3, 2));

  Display.drawBitmap(0, 0, condensatore, 128, 32, WHITE);
  Display.setTextSize(1);
  Display.setTextColor(WHITE);
  Display.setCursor(56, 0);
  Display.println("Capacimetro");
 
if (val < 1000) {
pinMode(IN_PIN, OUTPUT);
float capacitance = (float)val * IN_CAP_TO_GND / (float)(MAX_ADC_VALUE - val);
  Display.setTextSize(1);
  Display.setTextColor(WHITE);
Display.setCursor(0, 13);
Display.print(F("Capacita': "));
Display.print(capacitance, 3);
Display.print(F(" pF "));
Display.setCursor(0, 23);
Display.print("Tempo: ");
Display.print(val);
Display.print(" mS");
Display.display();
Serial.println(capacitance);
}
 
else {
pinMode(IN_PIN, OUTPUT);
delay(1);
pinMode(OUT_PIN, INPUT_PULLUP);
unsigned long u1 = micros();
unsigned long t;
int digVal;
 
do {
digVal = digitalRead(OUT_PIN);
unsigned long u2 = micros();
t = u2 > u1 ? u2 - u1 : u1 - u2;
}
 
while ((digVal < 1) && (t < 400000L));
 
pinMode(OUT_PIN, INPUT);
val = analogRead(OUT_PIN);
digitalWrite(IN_PIN, HIGH);
int dischargeTime = (int)(t / 1000L) * 5;
delay(dischargeTime);
pinMode(OUT_PIN, OUTPUT);
digitalWrite(OUT_PIN, LOW);
digitalWrite(IN_PIN, LOW);
 
float capacitance = -(float)t / R_PULLUP / log(1.0 - (float)val / (float)MAX_ADC_VALUE);
 
 
if (capacitance > 1000.0) {
  Display.setTextSize(1);
  Display.setTextColor(WHITE);
Display.setCursor(0, 13);
Display.print(F("Capacita': "));
Display.print(capacitance / 1000.0, 2);
Display.print(F(" uF "));
Display.setCursor(0, 23);
Display.print("Tempo: ");
Display.print(val);
Display.print(" mS");
Display.display();
Serial.println(capacitance);
}
 
else {
  Display.setTextSize(1);
  Display.setTextColor(WHITE);
Display.setCursor(0, 13);
Display.print(F("Capacita': "));
Display.print(capacitance, 2);
Display.print(F(" nF "));
Display.setCursor(0, 23);
Display.print("Tempo: ");
Display.print(val);
Display.print(" mS");
Display.display();
Serial.println(capacitance);
}
}
}

delay(600);
Display.clearDisplay();
}

String Format(double val, int dec, int dig ) {
  int addpad = 0;
  char sbuf[20];
  String fdata = (dtostrf(val, dec, dig, sbuf));
  int slen = fdata.length();
  for ( addpad = 1; addpad <= dec + dig - slen; addpad++) {
    fdata = " " + fdata;
  }
  return (fdata);
}
