#include <SPI.h>
#include <Wire.h>
#include <Adafruit_SSD1306.h>
#include <Adafruit_GFX.h>
#include <Fonts/FreeMonoBoldOblique24pt7b.h>

#define SCREEN_WIDTH 128 // OLED display width, in pixels
#define SCREEN_HEIGHT 32 // OLED display height, in pixels
#define OLED_RESET     4 // Reset pin # (or -1 if sharing Arduino reset pin)
Adafruit_SSD1306 Display(SCREEN_WIDTH, SCREEN_HEIGHT, &Wire, OLED_RESET);


int r = 0;
int i = 0;

double Vin = 5; // Volt in uscita dal Pin 5V di Arduino
float Vout = 0;
float R1 = 5100; // impostare il valore della resistenza nota in Ohm
float R2 = 0;
float buffer = 0;

static const unsigned char PROGMEM resistenza[] =
{ 0x02, 0x00, 0x20, 0x00, 0x00, 0x00, 0x00, 0x00, 0x00, 0x00, 0x00, 0x00, 0x00, 0x00, 0x00, 0x00,
  0x05, 0x00, 0x50, 0x00, 0x00, 0x00, 0x00, 0x00, 0x00, 0x00, 0x00, 0x00, 0x00, 0x00, 0x00, 0x00,
  0x08, 0x80, 0x88, 0x00, 0x00, 0x00, 0x00, 0x00, 0x00, 0x00, 0x00, 0x00, 0x00, 0x00, 0x00, 0x00,
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  0x00, 0x00, 0x00, 0x00, 0x00, 0x00, 0x00, 0x00, 0x00, 0x01, 0x00, 0x00, 0x00, 0x00, 0x00, 0x40
};

void setup() {
  Display.begin(SSD1306_SWITCHCAPVCC, 0x3C);
  Display.clearDisplay();
}

void loop() {
  int raw = analogRead(A1);
  if (raw) {
    buffer = raw * Vin;
    Vout = (buffer) / 1024.0;
    buffer = (Vin / Vout) - 1;
    R2 = R1 * buffer;
    Display.drawBitmap(0, 0, resistenza, 128, 32, WHITE);
    Display.setTextSize(1);
    Display.setTextColor(WHITE);
    Display.setCursor(73, 0);
    Display.println("Ohmmetro");
    Display.setTextColor(BLACK, WHITE);
    Display.setCursor(0, 33);
    Display.println(Format(r * 7.99 / 204.6, 3, 2));
    Display.setTextSize(1);
    Display.setTextColor(WHITE);
    Display.setCursor(4, 18);
    if (R2 < 1000) {
      Display.print(R2);
      Display.print(" Ohm");
      Display.display();
    }
    if (999 < R2 && R2 < 1000000) {
      Display.print(R2 / 1000);
      Display.print(" kOhm");
      Display.display();
    }
    if (999999 < R2 && R2 < 1700000) {
      Display.print(R2 / 1000000);
      Display.print(" MOhm");
      Display.display();
    }
    if (R2 > 1699999) {
      Display.cp437(true);
      int16_t i = 9;
      Display.setTextSize(2);
      Display.setCursor(0, 12);
      Display.print("o");
      Display.setCursor(8, 12);
      Display.print("o");
      Display.setCursor(16, 14);
      Display.print(" Inf");
      Display.display();
    }
    delay(200);
    Display.clearDisplay();
  }
}

String Format(double val, int dec, int dig ) {

  // this is my simple way of formatting a number
  // data = Format(number, digits, decimals) when needed

  int addpad = 0;
  char sbuf[20];
  String fdata = (dtostrf(val, dec, dig, sbuf));
  int slen = fdata.length();
  for ( addpad = 1; addpad <= dec + dig - slen; addpad++) {
    fdata = " " + fdata;
  }
  return (fdata);

}
